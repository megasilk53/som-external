// SPDX-License-Identifier: LicenseRef-Ezurio-Clause
/*
 * CTP SDIO DTS for Infineon IF91x — direct M.2 slot
 *
 * For the IF91x DVK board (cable assembly), use imx8mp-ctp-sdio-if91x-dvk instead.
 *
 * The IF91x is a programmable MCU that loads its application from NVRAM at
 * power-on — unlike a standard radio with masked ROM startup.  A 1-second
 * startup delay is required after W_DISABLE2# assertion before the SDIO bus
 * can be enumerated.
 *
 * CTP M.2 W_DISABLE signal routing:
 *   W_DISABLE2# (gpio3 22, SAI5_RXD1, ball AD16) — BT_REG_ON, pin 54.
 *     Drives the IF91x MCU internal regulator on the M.2 module.
 *     Used as vmmc-supply to usdhc1 with 1s startup delay.
 *   W_DISABLE1# (gpio2 6, SD1_DATA4, ball U26) — WL_REG_ON, pin 56.
 *     NOT connected on IF91x M.2 module.
 *     reg_m2_wdisable1 regulator-always-on removed so pin stays LOW
 *     (fail-safe: DVK users loading this overlay get immediate SDIO failure).
 *
 * Supply chain:
 *   reg_usdhc1_vmmc (M2_3V3, gpio1 11)
 *     → reg_m2_wdisable2 (W_DISABLE2#, gpio2 7, 1s startup)
 *       → usdhc1 vmmc-supply
 *
 * Copyright 2025-2026 Ezurio
 */

/dts-v1/;

#include "imx8mp-ctp-sdio.dtsi"

/ {
	model = "Summit i.MX8M Plus CTP + IF91x (M.2 direct)";
	compatible = "summit,imx8mp-ctp", "fsl,imx8mp";
};

/*
 * Override the M.2 W_DISABLE2# regulator:
 *   - Remove regulator-always-on so usdhc1 vmmc-supply gates the assertion.
 *   - Add vin-supply chain from M2_3V3.
 *   - Add 1s startup delay for IF91x MCU NVRAM boot time.
 */
&reg_m2_wdisable2 {
	/delete-property/ regulator-always-on;
	vin-supply = <&reg_usdhc1_vmmc>;
	startup-delay-us = <1000000>;
	off-on-delay-us = <100>;
};

/*
 * W_DISABLE1# (gpio2 6) is not connected on the IF91x M.2 module.
 * Remove regulator-always-on so the regulator stays disabled and the
 * pin is held LOW (enable-active-high + disabled = LOW).  This acts
 * as a fail-safe: if the DVK overlay is accidentally used instead,
 * W_DISABLE1# is HIGH (DVK needs it) and the MCU boots; here it is
 * LOW so any DVK user gets an immediate SDIO failure.
 */
&reg_m2_wdisable1 {
	/delete-property/ regulator-always-on;
};

&usdhc1 {
	vmmc-supply = <&reg_m2_wdisable2>;
};
